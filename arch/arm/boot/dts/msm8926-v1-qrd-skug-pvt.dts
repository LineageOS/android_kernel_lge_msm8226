/* Copyright (c) 2013-2014, The Linux Foundation. All rights reserved.
 *
 * This program is free software; you can redistribute it and/or modify
 * it under the terms of the GNU General Public License version 2 and
 * only version 2 as published by the Free Software Foundation.
 *
 * This program is distributed in the hope that it will be useful,
 * but WITHOUT ANY WARRANTY; without even the implied warranty of
 * MERCHANTABILITY or FITNESS FOR A PARTICULAR PURPOSE.  See the
 * GNU General Public License for more details.
 */

/dts-v1/;
/include/ "msm8926-v1.dtsi"
/include/ "msm8926-qrd-skug.dtsi"
/include/ "msm8926-w-memory.dtsi"
/include/ "msm8926-w-qseecom.dtsi"
/include/ "msm8926-w-sharedmem.dtsi"
/include/ "msm8926-w-ion.dtsi"

/ {
	model = "Qti MSM 8926v1 QRD SKUG PVT";
	compatible = "qcom,msm8926-qrd", "qcom,msm8926", "qcom,qrd";
	qcom,board-id = <0x2000b 5>;
};

&mdss_fb0 {
	/* cont_splash memory*/
	qcom,memblock-reserve = <0x0149c000 0x64000>;
};

&pm8226_vadc {
	chan@30 {
		label = "batt_therm";
		qcom,scale-function = <9>;
	};
};
