/* Copyright (c) 2012, Code Aurora Forum. All rights reserved.
 *
 * This program is free software; you can redistribute it and/or modify
 * it under the terms of the GNU General Public License version 2 and
 * only version 2 as published by the Free Software Foundation.
 *
 * This program is distributed in the hope that it will be useful,
 * but WITHOUT ANY WARRANTY; without even the implied warranty of
 * MERCHANTABILITY or FITNESS FOR A PARTICULAR PURPOSE.  See the
 * GNU General Public License for more details.
 */

/include/ "../msm8226-e7lte_att_us/msm8226-e7lte.dtsi"
/include/ "msm8226-e7lte-panel.dtsi"
/include/ "msm8226-e7lte-sensor.dtsi"
/include/ "msm8226-e7lte-hdmi.dtsi"
/include/ "msm8226-e7lte-usb.dtsi"
/include/ "msm8226-e7lte-misc.dtsi"
/include/ "msm8226-e7lte-pm.dtsi"
/include/ "msm8226-e7lte-camera.dtsi"
/include/ "msm8226-e7lte-input.dtsi"
/include/ "msm8226-e7lte-nfc.dtsi"  /* LGE_CHANGE, [NFC][garam.kim@lge.com], NFC Bring up */
/include/ "msm8226-e7lte-bt.dtsi" /* LGE_CHANGE, [BT] Bring up */
/include/ "msm8226-e7lte-sound.dtsi" /* LGE_CHANGE, [AUDIO] Bring up */

