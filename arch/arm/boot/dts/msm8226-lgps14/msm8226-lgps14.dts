/* Copyright (c) 2013, The Linux Foundation. All rights reserved.
 *
 * This program is free software; you can redistribute it and/or modify
 * it under the terms of the GNU General Public License version 2 and
 * only version 2 as published by the Free Software Foundation.
 *
 * This program is distributed in the hope that it will be useful,
 * but WITHOUT ANY WARRANTY; without even the implied warranty of
 * MERCHANTABILITY or FITNESS FOR A PARTICULAR PURPOSE.  See the
 * GNU General Public License for more details.
 */

/include/ "../msm8226-lge-common/msm8226-lge.dtsi"
/include/ "msm8226-lgps14.dtsi"

/ {
	model = "Qualcomm MSM 8226 lgps14";
	compatible = "qcom,msm8226-lgps14", "qcom,msm8226", "qcom,mtp";
	qcom,msm-id = <145 100 0>,
		      <158 100 0>,
		      <159 100 0>,
		      <198 100 0>,
		      <205 100 0>;

};
