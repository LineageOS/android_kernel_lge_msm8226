/* Copyright (c) 2013, The Linux Foundation. All rights reserved.
 *
 * This program is free software; you can redistribute it and/or modify
 * it under the terms of the GNU General Public License version 2 and
 * only version 2 as published by the Free Software Foundation.
 *
 * This program is distributed in the hope that it will be useful,
 * but WITHOUT ANY WARRANTY; without even the implied warranty of
 * MERCHANTABILITY or FITNESS FOR A PARTICULAR PURPOSE.  See the
 * GNU General Public License for more details.
 */

/include/ "../msm8226-lge-common/msm8926-lge.dtsi"
/include/ "msm8226-x3.dtsi"

/ {
	model = "Qualcomm MSM 8926 x3";
	compatible = "qcom,msm8926-x3_kr", "qcom,msm8926", "qcom,mtp";
	qcom,board-id = <141 0>;
	aliases {
		sdhc4 = &sdhc_2_rev_a; /* SDC2 SD card slot Rev.A */
	};
};
