/* Copyright (c) 2012, Code Aurora Forum. All rights reserved.
 *
 * This program is free software; you can redistribute it and/or modify
* it under the terms of the GNU General Public License version 2 and
* only version 2 as published by the Free Software Foundation.
*
* This program is distributed in the hope that it will be useful,
* but WITHOUT ANY WARRANTY; without even the implied warranty of
* MERCHANTABILITY or FITNESS FOR A PARTICULAR PURPOSE.  See the
* GNU General Public License for more details.
*/

&pm8226_chg {
        status = "ok";
        qcom,vddmax-mv = <4350>;
        qcom,vddsafe-mv = <4380>;
        qcom,ibatmax-ma = <1100>;
        qcom,vinmin-mv = <4350>;
        qcom,ibatterm-ma = <200>;
        qcom,vbatdet-delta-mv = <100>;
        qcom,tchg-mins = <480>;
        qcom,ext-ovp-present = <1>;
        qcom,power-stage-reduced;

        lge,ext_ovp_gpio = <&pm8226_gpios 2 0x00>;
};
