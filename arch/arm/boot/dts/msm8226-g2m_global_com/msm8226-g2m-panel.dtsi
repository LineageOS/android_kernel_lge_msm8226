/* Copyright (c) 2013, Code Aurora Forum. All rights reserved.
 *
 * This program is free software; you can redistribute it and/or modify
 * it under the terms of the GNU General Public License version 2 and
 * only version 2 as published by the Free Software Foundation.
 *
 * This program is distributed in the hope that it will be useful,
 * but WITHOUT ANY WARRANTY; without even the implied warranty of
 * MERCHANTABILITY or FITNESS FOR A PARTICULAR PURPOSE.  See the
 * GNU General Public License for more details.
 */

&mdss_dsi0 {
	qcom,dsi-pref-prim-pan = <&dsi_tianma_vid_dsv>;
};

&dsi_tianma_vid_dsv {
	qcom,cont-splash-enabled;
	qcom,enable-gpio = <&msmgpio 111 0>;
	qcom,mdss-dsi-h-front-porch = <82>;
	qcom,mdss-dsi-h-back-porch = <76>;
	qcom,mdss-dsi-h-pulse-width = <76>;
	qcom,mdss-dsi-h-sync-skew = <0>;
	qcom,mdss-dsi-v-back-porch = <15>;
	qcom,mdss-dsi-v-front-porch = <7>;
	qcom,mdss-dsi-v-pulse-width = <5>;
	qcom,mdss-dsi-panel-timings = [8E 2C 21 00 40 39 26 2E 39 03 04 00];
	qcom,mdss-dsi-t-clk-post = <0x1F>;
	qcom,mdss-dsi-t-clk-pre = <0x2F>;
};
