/* Copyright (c) 2012, Code Aurora Forum. All rights reserved.
 *
 * This program is free software; you can redistribute it and/or modify
 * it under the terms of the GNU General Public License version 2 and
 * only version 2 as published by the Free Software Foundation.
 *
 * This program is distributed in the hope that it will be useful,
 * but WITHOUT ANY WARRANTY; without even the implied warranty of
 * MERCHANTABILITY or FITNESS FOR A PARTICULAR PURPOSE.  See the
 * GNU General Public License for more details.
 */

&soc {
	earjack-debugger {
		status = "disable";
	};
/* moved to msm8610-xxx-camera.dtsi 2013-10-15 yt.jeon@lge.com
	i2c@0 {
		rt8542@39 {
			status = "ok";
			rt8542,max_current = <0x0C>;
			rt8542,max_brightness = <105>;
			rt8542,blmap = <
				10 10 12 12 12 14 14 16 16 18 
				18 19 19 20 20 22 22 22 24 24 
				26 26 28 28 29 29 30 30 32 32 
				32 34 34 36 36 38 38 39 39 40 
				40 42 42 42 44 44 46 46 48 48 
				49 49 50 50 52 52 52 54 54 56 
				56 58 58 59 59 60 60 62 62 62
				64 64 66 66 68 68 69 69 70 70 
				72 72 72 74 74 76 76 78 78 79 
				79 80 80 82 82 82 84 84 86 86 
				88 88 89 89 90 90 92 92 92 94 
				94 96 96 96 98 98 99 99 100 100
				102 102 104 104 105 105 105>;
		};
	};
*/
	hall-bu52061nvx {
                status = "ok";
    };
};
