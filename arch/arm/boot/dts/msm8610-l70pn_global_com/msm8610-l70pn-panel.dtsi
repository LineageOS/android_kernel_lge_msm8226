/* Copyright (c) 2013, Code Aurora Forum. All rights reserved.
 *
 * This program is free software; you can redistribute it and/or modify
 * it under the terms of the GNU General Public License version 2 and
 * only version 2 as published by the Free Software Foundation.
 *
 * This program is distributed in the hope that it will be useful,
 * but WITHOUT ANY WARRANTY; without even the implied warranty of
 * MERCHANTABILITY or FITNESS FOR A PARTICULAR PURPOSE.  See the
 * GNU General Public License for more details.
 */
&mdss_mdp {
	qcom,mdss-pref-prim-intf = "dsi";
};

&mdss_dsi0 {
    qcom,dsi-pref-prim-pan = <&dsi_lgd_incell_vid>;
	qcom,platform-enable-gpio = <&msmgpio 6 0>;
	qcom,platform-fd-gpio = <&msmgpio 20 0>;
	qcom,platform-pmode-gpio = <&msmgpio 75 0>;
};

&dsi_lgd_incell_vid {
};

