/* Copyright (c) 2012, Code Aurora Forum. All rights reserved.
 *
 * This program is free software; you can redistribute it and/or modify
 * it under the terms of the GNU General Public License version 2 and
 * only version 2 as published by the Free Software Foundation.
 *
 * This program is distributed in the hope that it will be useful,
 * but WITHOUT ANY WARRANTY; without even the implied warranty of
 * MERCHANTABILITY or FITNESS FOR A PARTICULAR PURPOSE.  See the
 * GNU General Public License for more details.
 */

/* LGE_CHANGE, [NFC][garam.kim@lge.com], NFC Bring up temp */
&soc {
	i2c@f9925000 {
		pn547@28 {
			compatible = "nxp,pn547";
			status = "ok";
			reg = <0x28>;
			interrupt-parent = <&msmgpio>;
			interrupts = <21 0x2>;
			nxp,gpio_sda = <&msmgpio 10 0x00>;
			nxp,gpio_scl = <&msmgpio 11 0x00>;
			nxp,gpio_ven = <&msmgpio 20 0x00>;
			nxp,gpio_mode = <&msmgpio 22 0x00>;
			nxp,gpio_irq = <&msmgpio 21 0x00>;
			nxp,i2c-pull-up = <1>;
		};
	};
};
