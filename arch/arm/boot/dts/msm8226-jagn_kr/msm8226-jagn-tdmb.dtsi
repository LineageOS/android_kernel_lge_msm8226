/* Copyright (c) 2013, The Linux Foundation. All rights reserved.
 *
 * This program is free software; you can redistribute it and/or modify
 * it under the terms of the GNU General Public License version 2 and
 * only version 2 as published by the Free Software Foundation.
 *
 * This program is distributed in the hope that it will be useful,
 * but WITHOUT ANY WARRANTY; without even the implied warranty of
 * MERCHANTABILITY or FITNESS FOR A PARTICULAR PURPOSE.  See the
 * GNU General Public License for more details.
 */

/ {
	soc {
		spi_tdmb: spi@f9923000 {  /* BLSP-1 QUP0 */
			compatible = "qcom,spi-qup-v2";
			reg = <0xf9923000 0x1000>, <0xf9904000 0x19000>;
			reg-names = "spi_physical","spi_bam_physical";

			interrupts = <0 95 0>, <0 238 0>;
			interrupt-names = "spi_irq", "spi_bam_irq";

			spi-max-frequency = <15000000>;
			#address-cells = <1>;
			#size-cells = <0>;
			qcom,gpio-mosi = <&msmgpio 0 0>;
			qcom,gpio-miso = <&msmgpio 1 0>;
			qcom,gpio-clk = <&msmgpio 3 0>;
			qcom,gpio-cs0 = <&msmgpio 2 0>;

			qcom,use-bam; //enable BAM-mode
			qcom,bam-consumer-pipe-index = <12>; //Consumer PIPE from table MSM8x26 BLSP SPI Pipe Assignment
			qcom,bam-producer-pipe-index = <13>; //Producer PIPE from table MSM8x26 BLSP SPI Pipe Assignment
			qcom,ver-reg-exists; //Version register exists (True for 8x26)
		};
	};
};

&spi_tdmb {
	tdmb@0 {
		compatible = "lge,tdmb";
		reg = <0>;
		interrupt-parent = <&msmgpio>;
		interrupts = <64 0x0>;
		spi-max-frequency = <15000000>;

		tdmb-fc8080,irq-gpio = <&msmgpio 64 0x00>;
		tdmb-fc8080,en-gpio = <&msmgpio 63 0x00>;
	};
};