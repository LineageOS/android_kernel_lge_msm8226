/* Copyright (c) 2013, The Linux Foundation. All rights reserved.
 *
 * This program is free software; you can redistribute it and/or modify
 * it under the terms of the GNU General Public License version 2 and
 * only version 2 as published by the Free Software Foundation.
 *
 * This program is distributed in the hope that it will be useful,
 * but WITHOUT ANY WARRANTY; without even the implied warranty of
 * MERCHANTABILITY or FITNESS FOR A PARTICULAR PURPOSE.  See the
 * GNU General Public License for more details.
 */

/include/ "../msm8226-lge-common/msm8226-v2-lge.dtsi"
/include/ "msm8226-w7.dtsi"

/ {
	model = "Qualcomm MSM 8226v2 w7opencis";
	compatible = "qcom,msm8226-w7opencis", "qcom,msm8226", "qcom,mtp";
	qcom,board-id = <101 0>;
};
