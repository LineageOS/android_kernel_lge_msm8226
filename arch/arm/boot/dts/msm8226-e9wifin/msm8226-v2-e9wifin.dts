/* Copyright (c) 2013, The Linux Foundation. All rights reserved.
 *
 * This program is free software; you can redistribute it and/or modify
 * it under the terms of the GNU General Public License version 2 and
 * only version 2 as published by the Free Software Foundation.
 *
 * This program is distributed in the hope that it will be useful,
 * but WITHOUT ANY WARRANTY; without even the implied warranty of
 * MERCHANTABILITY or FITNESS FOR A PARTICULAR PURPOSE.  See the
 * GNU General Public License for more details.
 */

/include/ "../msm8226-lge-common/msm8226-v2-lge.dtsi"
/include/ "msm8226-e9wifin.dtsi"

/ {
	model = "Qualcomm MSM 8226v2 e9wifin";
	compatible = "qcom,msm8226-e9wifin", "qcom,msm8226", "qcom,mtp";
	qcom,msm-id = <199 0x20000>,
                  <219 0x20000>;
	qcom,board-id = <171 0>;
	aliases {
		sdhc4 = &sdhc_2_rev_a; /* SDC2 SD card slot Rev.A */
	};
};
