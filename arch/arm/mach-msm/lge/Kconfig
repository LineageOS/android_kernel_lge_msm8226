## drivers/broadcast/Kconfig
```kconfig
# LGE Broadcast Device Driver Support

menu "LGE Broadcast Device Support"


config LGE_BROADCAST_ONESEG
	bool "1Seg Broadcast service"
	depends on (MACH_MSM8X10_W3DS_TIM_BR) || (MACH_MSM8X10_W3DS_OPEN_SCA) || (MACH_MSM8X10_W3TS_OPEN_SCA) || (MACH_MSM8X10_W6DS_GLOBAL_SCA) || (MACH_MSM8X10_W6DS_TIM_BR) || (MACH_MSM8X10_W3TS_GLOBAL_SCA) || (MACH_MSM8X10_W3_GLOBAL_SCA) || (MACH_MSM8X10_W35_GLOBAL_SCA) || (MACH_MSM8X10_W35DS_GLOBAL_SCA) || (MACH_MSM8X10_W6_GLOBAL_SCA)
	default y
	help
	  Select this if you want to use Japanese 1Seg mobile broadcast service

config LGE_BROADCAST_BRAZIL_FREQ
	bool "1Seg Broadcast service"
	depends on (MACH_MSM8X10_W3DS_TIM_BR) || (MACH_MSM8X10_W3DS_OPEN_SCA) || (MACH_MSM8X10_W3TS_OPEN_SCA) || (MACH_MSM8X10_W6DS_GLOBAL_SCA) || (MACH_MSM8X10_W6DS_TIM_BR) || (MACH_MSM8X10_W3TS_GLOBAL_SCA) || (MACH_MSM8X10_W3_GLOBAL_SCA) || (MACH_MSM8X10_W35_GLOBAL_SCA) || (MACH_MSM8X10_W35DS_GLOBAL_SCA) || (MACH_MSM8X10_W6_GLOBAL_SCA)
	default y
	help
	  Select this if you want to use Japanese 1Seg mobile broadcast service
	  
config LGE_BROADCAST_TDMB
	bool "LGE broadcast TDMB device Driver"
	depends on (MACH_MSM8926_JAGN_KR) || (MACH_MSM8926_B2LN_KR) || (MACH_MSM8926_VFP_KR) || (MACH_MSM8926_AKA_KR)
	default y
	help
	  Select this if you want to use TDMB broadcast service

source "drivers/broadcast/oneseg/Kconfig"
source "drivers/broadcast/tdmb/Kconfig"

endmenu
```

## drivers/broadcast/oneseg/Kconfig
```kconfig
#
# Broadcast Device Driver Support
#

menu "LGE Japanese Mobile Broadcast(ISDB-T 1seg/ISDB-Tmm 13seg) Device Support"
	  
config LGE_BROADCAST_ONESEG_MTV222
	bool "1Seg broacast tuner chipset MTV222 device driver"
	depends on LGE_BROADCAST_ONESEG && ((MACH_MSM8X10_W6DS_TIM_BR) || (MACH_MSM8X10_W6DS_GLOBAL_SCA) || (MACH_MSM8X10_W6_GLOBAL_SCA))
	default y
	help
	  Select this if you want to use Japanese 1Seg mobile broadcast service

config LGE_BROADCAST_ONESEG_FC8150
	bool "1Seg broacast tuner chipset fc8150 device driver"
	depends on LGE_BROADCAST_ONESEG && ((MACH_MSM8X10_W3DS_TIM_BR) || (MACH_MSM8X10_W3DS_OPEN_SCA) || (MACH_MSM8X10_W3_GLOBAL_SCA) || (MACH_MSM8X10_W3TS_OPEN_SCA) || (MACH_MSM8X10_W6DS_GLOBAL_SCA) || (MACH_MSM8X10_W6DS_TIM_BR) || (MACH_MSM8X10_W35_GLOBAL_SCA) || (MACH_MSM8X10_W35DS_GLOBAL_SCA)) || (MACH_MSM8X10_W3TS_GLOBAL_SCA)
	default y
	help
	  Select this if you want to use Japanese 1Seg mobile broadcast service
	  
endmenu
```

## drivers/broadcast/oneseg/mtv222/Kconfig
```kconfig
#
# MTV222_DEVICE subsystem configuration
#

#menu "MTV222 support"

config MTV222_ISDBT
	default n
	---help---
	  This driver implements the front-end of the Xen virtual
	  keyboard and mouse device driver.  It communicates with a back-end
	  in another domain.
#endmenu
```

## drivers/char/diag/Kconfig
```kconfig
menu "Diag Support"

config DIAG_CHAR
	tristate "char driver interface and diag forwarding to/from modem"
	default m
	depends on USB_G_ANDROID || USB_FUNCTION_DIAG || USB_QCOM_MAEMO
	depends on ARCH_MSM
	help
	 Char driver interface for diag user space and diag-forwarding to modem ARM and back.
	 This enables diagchar for maemo usb gadget or android usb gadget based on config selected.
endmenu

menu "DIAG traffic over USB"

config DIAG_OVER_USB
	bool "Enable DIAG traffic to go over USB"
        depends on ARCH_MSM
	default y
	help
	 This feature helps segregate code required for DIAG traffic to go over USB.
endmenu

menu "SLATE Support"

config LGE_SLATE
	bool "Enable SLATE Key Logging message routing"
		depends on DIAG_OVER_USB
	default n
	help
	 This feature helps decide whether slate key logging start message would be routed to apps or not.
endmenu

menu "SDIO support for DIAG"

config DIAG_SDIO_PIPE
	depends on MSM_SDIO_AL
	default y
	bool "Enable 9K DIAG traffic over SDIO"
	help
	 SDIO Transport Layer for DIAG Router
endmenu

menu "HSIC/SMUX support for DIAG"

config DIAGFWD_BRIDGE_CODE
	depends on USB_QCOM_DIAG_BRIDGE
	default y
	bool "Enable QSC/9K DIAG traffic over SMUX/HSIC"
	help
	 SMUX/HSIC Transport Layer for DIAG Router
endmenu

menu "LGE DM APP Support"

config LGE_DM_APP
	bool "LGE DM APP Support"
	default n
	depends on MACH_LGE
	help
	 LGE DM APP Support
endmenu

menu "LGE DM DEV Support"

config LGE_DM_DEV
    bool "LGE DM DEV Support"
    default n
    depends on MACH_LGE
    help
     LGE DM DEV Support
endmenu

menu "LGE RSSI debug Support"

config LGE_RSSI_DEBUG
   bool "LGE RSSI_DEBUG Support"
   default n
   depends on MACH_LGE
   help
    LGE RSSI DEBUG Support
endmenu

menu "LGE Diag Enable for TRF/SPR"

config LGE_DIAG_ENABLE
    bool "LGE Diag Enable for TRF/SPR"
    default n
	help
     LGE Diag Enable for TRF/SPR
endmenu

menu "LGE Diag Enable for SPR"

config LGE_DIAG_ENABLE_SPR
    bool "LGE Diag Enable for SPR"
    default n
	help
     LGE Diag Enable for SPR

endmenu

menu "LGE ACG Carrier Code"

config LGE_ACG_CARRIER_CODE
    bool "LGE ACG Carrier Code"
    default n
    depends on MACH_LGE
    help
     LGE ACG Carrier Code
endmenu
```

## drivers/input/sensor/Kconfig
```kconfig
# LGE_CHANGE_S: define kconfig for sensors
#
# Sensor driver configuration
#
menuconfig INPUT_SENSOR
	bool "Sensors"
	help
	  Say Y here, and a list of supported touchscreens will be displayed.
	  This option doesn't affect the kernel.

	  If unsure, say Y.

if INPUT_SENSOR


config SENSORS_BMC150_COMMON
	bool
	default n

config SENSORS_BMA2X2
	tristate "BMA255/BMA250E/BMA222E/BMA280 acceleration sensor support"
	depends on I2C=y
	select SENSORS_BMC150_COMMON
	help
	  If you say yes here you get support for Bosch Sensortec's
	  acceleration sensors BMA255/BMA250E/BMA222E/BMA280.


config SENSORS_BMM050
	tristate "BMM050 Magnetic Sensor Driver"
	depends on I2C=y
	select SENSORS_BMC150_COMMON
	help
	 BMM050 Magnetic Sensor Driver implemented by Bosch-Sensortec.

config SENSORS_K2DH
	tristate "K2DH STM acceleration sensor"
	depends on I2C=y
	help
	 acceleration sensor STM K2DH

config SENSOR_K2DH
    bool "K2DH support"
    depends on I2C
    help
     Support K2DH as an input device.

config SENSOR_AK09911
   bool "AK09911 support"
   depends on I2C
   help
     Support AK09911 as an input device.

config SENSOR_APDS9130
       tristate "APDS9130 Proximity Sensor Driver"
       depends on I2C
       help
        APDS9130 Proximity Sensor Driver implemented by Avago Tech.

config SENSOR_APDS9190
       tristate "APDS9190 Proximity Sensor Driver"
       depends on I2C
       help
        APDS9190 Proximity Sensor Driver implemented by Avago Tech.

config SENSOR_K303C
       tristate "K303C Accelerometer & Magnetometer Driver"
       depends on I2C
       help
       K303C Accelerometer & Magnetomerer Sensor Driver implemented by ST Micro Electronics.

config SENSOR_LGE_DT
       tristate "KNOCK-ON Driver"
       depends on I2C
       default n
       help
         Say Y here if you use lge knock-on
         If unsure, say N.

config SENSOR_SX9500
    tristate "SX9500 based capacitive touch button"
    depends on I2C
    help
      Say Y here if you have a SX9500.
      If unsure, say N.

      To compile this driver as a module, choose M here: the
      module will be called sx8651.

config SENSOR_SX9311
    tristate "SX9311 based capacitive touch button"
    depends on I2C
    help
      Say Y here if you have a SX9311.
      If unsure, say N.

      To compile this driver as a module, choose M here: the
      module will be called sx8651.

config SENSOR_ATMF04
    bool "ATMF04 Support"
    depends on I2C
    help
      Support ATMF04 as an input device.
endif
# LGE_CHANGE_E
```
